## Config.in
```kconfig
source "$BR2_EXTERNAL_SOSUBOOT_TEGRA_PATH/packages/cbootimage/Config.in"
source "$BR2_EXTERNAL_SOSUBOOT_TEGRA_PATH/packages/abootimg/Config.in"
source "$BR2_EXTERNAL_SOSUBOOT_TEGRA_PATH/packages/makeself/Config.in.host"
source "$BR2_EXTERNAL_SOSUBOOT_TEGRA_PATH/packages/ac100-self-installers/Config.in"
source "$BR2_EXTERNAL_SOSUBOOT_TEGRA_PATH/packages/android-installer/Config.in"
```

## configs/tegra20-paz00_defconfig
```kconfig
BR2_arm=y
BR2_cortex_a9=y
BR2_ARM_ENABLE_VFP=y
BR2_PACKAGE_HOST_LINUX_HEADERS_CUSTOM_4_4=y
BR2_TOOLCHAIN_BUILDROOT_WCHAR=y
BR2_TOOLCHAIN_BUILDROOT_CXX=y
BR2_TARGET_GENERIC_HOSTNAME="sosuboot-paz00"
BR2_TARGET_GENERIC_ISSUE="Welcome to SOSUBoot"
BR2_ROOTFS_DEVICE_CREATION_DYNAMIC_EUDEV=y
BR2_ROOTFS_MERGED_USR=y
BR2_TARGET_GENERIC_ROOT_PASSWD="linux"
BR2_SYSTEM_BIN_SH_BASH=y
BR2_TARGET_TZ_INFO=y
BR2_ROOTFS_OVERLAY="$(BR2_EXTERNAL)/board/tegra20/paz00/rootfs_overlay/"
BR2_ROOTFS_POST_BUILD_SCRIPT="$(BR2_EXTERNAL)/board/tegra20/paz00/post_build.sh"
BR2_ROOTFS_POST_IMAGE_SCRIPT="$(BR2_EXTERNAL)/board/tegra20/paz00/post_image.sh"
BR2_ROOTFS_POST_SCRIPT_ARGS="$(BR2_EXTERNAL) $(BR2_VERSION_FULL) $(BINARIES_DIR)"
BR2_LINUX_KERNEL=y
BR2_LINUX_KERNEL_DEFCONFIG="tegra"
BR2_LINUX_KERNEL_ZIMAGE=y
BR2_LINUX_KERNEL_DTS_SUPPORT=y
BR2_LINUX_KERNEL_INTREE_DTS_NAME="tegra20-paz00"
BR2_PACKAGE_BUSYBOX_SHOW_OTHERS=y
BR2_PACKAGE_BUSYBOX_WATCHDOG=y
BR2_PACKAGE_DOSFSTOOLS=y
BR2_PACKAGE_DOSFSTOOLS_FATLABEL=y
BR2_PACKAGE_DOSFSTOOLS_FSCK_FAT=y
BR2_PACKAGE_DOSFSTOOLS_MKFS_FAT=y
BR2_PACKAGE_E2FSPROGS=y
BR2_PACKAGE_E2FSPROGS_RESIZE2FS=y
BR2_PACKAGE_LINUX_FIRMWARE=y
BR2_PACKAGE_LINUX_FIRMWARE_RALINK_RT2XX=y
BR2_PACKAGE_GPM=y
BR2_PACKAGE_GPM_INSTALL_TEST_TOOLS=y
BR2_PACKAGE_GPTFDISK=y
BR2_PACKAGE_GPTFDISK_SGDISK=y
BR2_PACKAGE_I2C_TOOLS=y
BR2_PACKAGE_UBOOT_TOOLS=y
BR2_PACKAGE_UBOOT_TOOLS_MKIMAGE=y
BR2_PACKAGE_UBOOT_TOOLS_MKENVIMAGE=y
BR2_PACKAGE_USBUTILS=y
BR2_PACKAGE_NCURSES_WCHAR=y
BR2_PACKAGE_CONNMAN=y
BR2_PACKAGE_CONNMAN_WIFI=y
BR2_PACKAGE_CONNMAN_BLUETOOTH=y
BR2_PACKAGE_CONNMAN_CLIENT=y
BR2_PACKAGE_DHCP=y
BR2_PACKAGE_DHCP_CLIENT=y
BR2_PACKAGE_DROPBEAR=y
BR2_PACKAGE_DROPBEAR_WTMP=y
BR2_PACKAGE_DROPBEAR_LASTLOG=y
BR2_PACKAGE_WIRELESS_TOOLS=y
BR2_PACKAGE_WIRELESS_TOOLS_LIB=y
BR2_PACKAGE_WPA_SUPPLICANT_DEBUG_SYSLOG=y
BR2_PACKAGE_WPA_SUPPLICANT_WPS=y
BR2_PACKAGE_WPA_SUPPLICANT_CLI=y
BR2_PACKAGE_WPA_SUPPLICANT_PASSPHRASE=y
BR2_PACKAGE_LOCKFILE_PROGS=y
BR2_PACKAGE_SCREEN=y
BR2_PACKAGE_KMOD_TOOLS=y
BR2_PACKAGE_UTIL_LINUX_BINARIES=y
BR2_PACKAGE_UTIL_LINUX_UUIDD=y
BR2_TARGET_ROOTFS_CPIO=y
BR2_TARGET_ROOTFS_CPIO_UIMAGE=y
# BR2_TARGET_ROOTFS_TAR is not set
BR2_TARGET_UBOOT=y
BR2_TARGET_UBOOT_BUILD_SYSTEM_KCONFIG=y
BR2_TARGET_UBOOT_BOARD_DEFCONFIG="paz00"
BR2_TARGET_UBOOT_NEEDS_DTC=y
BR2_TARGET_UBOOT_FORMAT_CUSTOM=y
BR2_TARGET_UBOOT_FORMAT_CUSTOM_NAME="{u-boot,u-boot-dtb-tegra.bin,u-boot-nodtb-tegra.bin,u-boot.dtb}"
BR2_PACKAGE_CBOOTIMAGE=y
BR2_PACKAGE_HOST_CBOOTIMAGE=y
BR2_PACKAGE_ABOOTIMG=y
BR2_PACKAGE_AC100_SELF_INSTALLERS=y
BR2_PACKAGE_HOST_TEGRARCM=y
BR2_PACKAGE_ANDROID_INSTALLER=y
```

## configs/tegra20-paz00_ext4_defconfig
```kconfig
BR2_arm=y
BR2_cortex_a9=y
BR2_ARM_ENABLE_VFP=y
BR2_OPTIMIZE_2=y
BR2_PACKAGE_HOST_LINUX_HEADERS_CUSTOM_4_4=y
BR2_TOOLCHAIN_BUILDROOT_GLIBC=y
BR2_TOOLCHAIN_BUILDROOT_CXX=y
BR2_GENERATE_LOCALE="en_US.UTF-8"
BR2_TARGET_GENERIC_HOSTNAME="sosuboot-paz00"
BR2_TARGET_GENERIC_ISSUE="Welcome to SOSUBoot"
BR2_ROOTFS_DEVICE_CREATION_DYNAMIC_EUDEV=y
BR2_ROOTFS_MERGED_USR=y
BR2_TARGET_GENERIC_ROOT_PASSWD="linux"
BR2_SYSTEM_BIN_SH_BASH=y
BR2_TARGET_TZ_INFO=y
BR2_ROOTFS_OVERLAY="$(BR2_EXTERNAL)/board/tegra20/paz00/rootfs_overlay/"
BR2_ROOTFS_POST_BUILD_SCRIPT="$(BR2_EXTERNAL)/board/tegra20/paz00/post_build.sh"
BR2_ROOTFS_POST_IMAGE_SCRIPT="$(BR2_EXTERNAL)/board/tegra20/paz00/post_image_ext4.sh"
BR2_ROOTFS_POST_SCRIPT_ARGS="$(BR2_EXTERNAL) $(BR2_VERSION_FULL) $(BINARIES_DIR)"
BR2_LINUX_KERNEL=y
BR2_LINUX_KERNEL_PATCH="$(BR2_EXTERNAL)/board/tegra20/paz00/kernel-patch/"
BR2_LINUX_KERNEL_DEFCONFIG="tegra"
BR2_LINUX_KERNEL_DTS_SUPPORT=y
BR2_LINUX_KERNEL_INTREE_DTS_NAME="tegra20-paz00"
BR2_LINUX_KERNEL_INSTALL_TARGET=y
BR2_PACKAGE_BUSYBOX_SHOW_OTHERS=y
BR2_PACKAGE_BUSYBOX_WATCHDOG=y
BR2_PACKAGE_ALSA_UTILS=y
BR2_PACKAGE_BZIP2=y
BR2_PACKAGE_GZIP=y
BR2_PACKAGE_XZ=y
BR2_PACKAGE_IOZONE=y
BR2_PACKAGE_STRACE=y
BR2_PACKAGE_DOS2UNIX=y
BR2_PACKAGE_FINDUTILS=y
BR2_PACKAGE_GETTEXT=y
BR2_PACKAGE_GIT=y
BR2_PACKAGE_SED=y
BR2_PACKAGE_DOSFSTOOLS=y
BR2_PACKAGE_DOSFSTOOLS_FATLABEL=y
BR2_PACKAGE_DOSFSTOOLS_FSCK_FAT=y
BR2_PACKAGE_DOSFSTOOLS_MKFS_FAT=y
BR2_PACKAGE_E2FSPROGS=y
BR2_PACKAGE_E2FSPROGS_RESIZE2FS=y
BR2_PACKAGE_NTFS_3G=y
BR2_PACKAGE_BITSTREAM_VERA=y
BR2_PACKAGE_DEJAVU=y
BR2_PACKAGE_LIBERATION=y
BR2_PACKAGE_MESA3D_DEMOS=y
BR2_PACKAGE_MESA3D=y
BR2_PACKAGE_MESA3D_GALLIUM_DRIVER_SWRAST=y
BR2_PACKAGE_MESA3D_DRI_DRIVER_SWRAST=y
BR2_PACKAGE_MESA3D_OPENGL_EGL=y
BR2_PACKAGE_MESA3D_OPENGL_ES=y
BR2_PACKAGE_SDL2=y
BR2_PACKAGE_SDL2_X11=y
BR2_PACKAGE_XORG7=y
BR2_PACKAGE_XSERVER_XORG_SERVER=y
BR2_PACKAGE_XSERVER_XORG_SERVER_AIGLX=y
BR2_PACKAGE_XAPP_SETXKBMAP=y
BR2_PACKAGE_XAPP_XINIT=y
BR2_PACKAGE_XAPP_XMODMAP=y
BR2_PACKAGE_XDRIVER_XF86_INPUT_LIBINPUT=y
BR2_PACKAGE_XDRIVER_XF86_VIDEO_FBDEV=y
BR2_PACKAGE_DILLO=y
BR2_PACKAGE_XTERM=y
BR2_PACKAGE_OPENBOX=y
BR2_PACKAGE_LINUX_FIRMWARE=y
BR2_PACKAGE_LINUX_FIRMWARE_RALINK_RT2XX=y
BR2_PACKAGE_GPM=y
BR2_PACKAGE_GPM_INSTALL_TEST_TOOLS=y
BR2_PACKAGE_GPTFDISK=y
BR2_PACKAGE_GPTFDISK_SGDISK=y
BR2_PACKAGE_I2C_TOOLS=y
BR2_PACKAGE_OFONO=y
BR2_PACKAGE_UBOOT_TOOLS=y
BR2_PACKAGE_UBOOT_TOOLS_MKIMAGE=y
BR2_PACKAGE_UBOOT_TOOLS_MKENVIMAGE=y
BR2_PACKAGE_USB_MODESWITCH_DATA=y
BR2_PACKAGE_USBMOUNT=y
BR2_PACKAGE_USBUTILS=y
BR2_PACKAGE_SQLITE=y
BR2_PACKAGE_CAIRO_PNG=y
BR2_PACKAGE_WAYLAND=y
BR2_PACKAGE_LIBXKBCOMMON=y
BR2_PACKAGE_ICU=y
BR2_PACKAGE_NCURSES_WCHAR=y
BR2_PACKAGE_PCRE_16=y
BR2_PACKAGE_MUTT=y
BR2_PACKAGE_MUTT_IMAP=y
BR2_PACKAGE_CONNMAN=y
BR2_PACKAGE_CONNMAN_WIFI=y
BR2_PACKAGE_CONNMAN_BLUETOOTH=y
BR2_PACKAGE_CONNMAN_CLIENT=y
BR2_PACKAGE_DHCP=y
BR2_PACKAGE_DHCP_CLIENT=y
BR2_PACKAGE_DROPBEAR=y
BR2_PACKAGE_DROPBEAR_WTMP=y
BR2_PACKAGE_DROPBEAR_LASTLOG=y
BR2_PACKAGE_IPROUTE2=y
BR2_PACKAGE_IRSSI=y
BR2_PACKAGE_IRSSI_TRUE_COLOR=y
BR2_PACKAGE_LFTP=y
BR2_PACKAGE_LINKS=y
BR2_PACKAGE_MODEM_MANAGER=y
BR2_PACKAGE_MODEM_MANAGER_LIBMBIM=y
BR2_PACKAGE_WIRELESS_TOOLS=y
BR2_PACKAGE_WIRELESS_TOOLS_LIB=y
BR2_PACKAGE_WPA_SUPPLICANT_DEBUG_SYSLOG=y
BR2_PACKAGE_WPA_SUPPLICANT_WPS=y
BR2_PACKAGE_WPA_SUPPLICANT_CLI=y
BR2_PACKAGE_WPA_SUPPLICANT_PASSPHRASE=y
BR2_PACKAGE_SCREEN=y
BR2_PACKAGE_KMOD_TOOLS=y
BR2_PACKAGE_UTIL_LINUX_BINARIES=y
BR2_PACKAGE_UTIL_LINUX_UUIDD=y
BR2_PACKAGE_VIM=y
BR2_TARGET_ROOTFS_EXT2=y
BR2_TARGET_ROOTFS_EXT2_4=y
BR2_TARGET_ROOTFS_EXT2_LABEL="rootfs"
# BR2_TARGET_ROOTFS_TAR is not set
BR2_TARGET_UBOOT=y
BR2_TARGET_UBOOT_BUILD_SYSTEM_KCONFIG=y
BR2_TARGET_UBOOT_BOARD_DEFCONFIG="paz00"
BR2_TARGET_UBOOT_NEEDS_DTC=y
BR2_TARGET_UBOOT_FORMAT_CUSTOM=y
BR2_TARGET_UBOOT_FORMAT_CUSTOM_NAME="{u-boot,u-boot-dtb-tegra.bin,u-boot-nodtb-tegra.bin,u-boot.dtb}"
BR2_PACKAGE_HOST_CBOOTIMAGE=y
BR2_PACKAGE_HOST_GENIMAGE=y
BR2_PACKAGE_HOST_GENPART=y
BR2_PACKAGE_HOST_TEGRARCM=y
BR2_PACKAGE_HOST_UBOOT_TOOLS=y
BR2_PACKAGE_CBOOTIMAGE=y
BR2_PACKAGE_ABOOTIMG=y
BR2_PACKAGE_AC100_SELF_INSTALLERS=y
BR2_PACKAGE_ANDROID_INSTALLER=y
```

## configs/tegra20-paz00_temp_defconfig
```kconfig
BR2_arm=y
BR2_cortex_a9=y
BR2_ARM_ENABLE_VFP=y
BR2_ARM_EABI=y
BR2_TOOLCHAIN_EXTERNAL=y
BR2_ENABLE_LOCALE_PURGE=y
BR2_ENABLE_LOCALE_WHITELIST="C en_US"
BR2_TARGET_GENERIC_HOSTNAME="sosuboot-paz00"
BR2_TARGET_GENERIC_ISSUE="Welcome to SOSUBoot"
BR2_ROOTFS_DEVICE_CREATION_DYNAMIC_EUDEV=y
BR2_ROOTFS_MERGED_USR=y
BR2_TARGET_GENERIC_ROOT_PASSWD="linux"
BR2_SYSTEM_BIN_SH_BASH=y
BR2_ROOTFS_OVERLAY="$(BR2_EXTERNAL)/board/tegra20/paz00/rootfs_overlay/"
BR2_ROOTFS_POST_BUILD_SCRIPT="$(BR2_EXTERNAL)/board/tegra20/paz00/post_build.sh"
BR2_ROOTFS_POST_IMAGE_SCRIPT="$(BR2_EXTERNAL)/board/tegra20/paz00/post_image.sh"
BR2_ROOTFS_POST_SCRIPT_ARGS="$(BR2_EXTERNAL) $(BR2_VERSION_FULL) $(BINARIES_DIR)"
BR2_LINUX_KERNEL=y
BR2_LINUX_KERNEL_CUSTOM_VERSION=y
BR2_LINUX_KERNEL_CUSTOM_VERSION_VALUE="@LINUX_VERSION"
BR2_LINUX_KERNEL_PATCH="$(BR2_EXTERNAL)/board/tegra20/paz00/kernel-patch/"
BR2_LINUX_KERNEL_DEFCONFIG="tegra"
BR2_LINUX_KERNEL_ZIMAGE=y
BR2_LINUX_KERNEL_DTS_SUPPORT=y
BR2_LINUX_KERNEL_INTREE_DTS_NAME="tegra20-paz00"
BR2_PACKAGE_BUSYBOX_SHOW_OTHERS=y
BR2_PACKAGE_BUSYBOX_WATCHDOG=y
BR2_PACKAGE_LINUX_FIRMWARE=y
BR2_PACKAGE_LINUX_FIRMWARE_RALINK_RT2XX=y
BR2_PACKAGE_GPM=y
BR2_PACKAGE_GPTFDISK=y
BR2_PACKAGE_GPTFDISK_SGDISK=y
BR2_PACKAGE_I2C_TOOLS=y
BR2_PACKAGE_UBOOT_TOOLS=y
BR2_PACKAGE_UBOOT_TOOLS_MKIMAGE=y
BR2_PACKAGE_UBOOT_TOOLS_MKENVIMAGE=y
BR2_PACKAGE_NCURSES_WCHAR=y
BR2_PACKAGE_KMOD_TOOLS=y
BR2_PACKAGE_UTIL_LINUX_BINARIES=y
BR2_PACKAGE_UTIL_LINUX_UUIDD=y
BR2_TARGET_ROOTFS_CPIO=y
BR2_TARGET_ROOTFS_CPIO_UIMAGE=y
# BR2_TARGET_ROOTFS_TAR is not set
BR2_TARGET_UBOOT=y
BR2_TARGET_UBOOT_BUILD_SYSTEM_KCONFIG=y
BR2_TARGET_UBOOT_BOARD_DEFCONFIG="paz00"
BR2_TARGET_UBOOT_NEEDS_DTC=y
BR2_TARGET_UBOOT_FORMAT_CUSTOM=y
BR2_TARGET_UBOOT_FORMAT_CUSTOM_NAME="{u-boot,u-boot-dtb-tegra.bin,u-boot-nodtb-tegra.bin,u-boot.dtb}"
BR2_PACKAGE_HOST_TEGRARCM=y
```

## packages/abootimg/Config.in
```kconfig
config BR2_PACKAGE_ABOOTIMG
	bool "abootimg"
	select BR2_PACKAGE_UTIL_LINUX
	select BR2_PACKAGE_UTIL_LINUX_LIBBLKID
	select BR2_PACKAGE_UTIL_LINUX_LIBUUID
	help
	  Tool to read/write/update android boot images
	  
	  Android devices use a special partition format to boot any
	  operating system on the devices. These boot-images contain
	  a kernel image, a ramdisk, optionally a 2nd stage boot loader
	  and the commandline passed to the kernel when booting.
	  The original mkbootimg from Android can only create these images
	  where abootimg can also extract and modify them.
	  Handling android boot images is necessary when bringing other
	  operating systems to android devices.

	  https://github.com/ggrandou/abootimg
```

## packages/ac100-self-installers/Config.in
```kconfig
config BR2_PACKAGE_AC100_SELF_INSTALLERS
	bool "ac100-self-installers"
	select BR2_PACKAGE_HOST_MAKESELF
	help
	  Scripts to replace factory bootloader on Toshiba AC100 with U-Boot.

	  https://github.com/Stuw/ac100-self-installers
```

## packages/android-installer/Config.in
```kconfig
config BR2_PACKAGE_ANDROID_INSTALLER
	bool "android-installer"
	help
	  Script to help with Android installation on Toshiba AC100

	  https://github.com/ac100-ru/android-installer
```

## packages/cbootimage/Config.in
```kconfig
config BR2_PACKAGE_CBOOTIMAGE
	bool "cbootimage"
	help
	  This project provides a tool which compiles BCT (Boot Configuration
	  Table) images to place into the boot flash of a Tegra-based device.

	  https://github.com/NVIDIA/cbootimage
```

## packages/makeself/Config.in.host
```kconfig
config BR2_PACKAGE_HOST_MAKESELF
	bool "host makeself"
	help
	  This project provides a tool which make self-extractable archives on Unix.

	  https://github.com/megastep/makeself
```

## packages/tegrarcm/Config.in.host
```kconfig
config BR2_PACKAGE_HOST_TEGRARCM
	bool "host tegrarcm"
	help
	  This program is used to send code to a Tegra device in recovery
	  mode.

	  https://github.com/NVIDIA/tegrarcm
```

## packages/xdriver_xf86-video-opentegra/Config.in
```kconfig
config BR2_PACKAGE_XDRIVER_XF86_VIDEO_OPENTEGRA
        bool "xf86-video-opentegra"
        depends on BR2_arm
        select BR2_PACKAGE_LIBDRM
        select BR2_PACKAGE_LIBDRM_TEGRA
        select BR2_PACKAGE_XPROTO_XPROTO
        select BR2_PACKAGE_XPROTO_RANDRPROTO
        select BR2_PACKAGE_XPROTO_XF86DRIPROTO
        help
          Open-source X.org graphics driver for NVIDIA Tegra

          To use this driver, add correct configuration to your
          /etc/X11/xorg.conf:

          Section "Device"
            [...]
            Driver          "opentegra"
          EndSection
```
